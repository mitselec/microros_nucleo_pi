## CMakeLists.txt
```
cmake_minimum_required(VERSION 3.20.0)

# The micro-ROS clone (used via west) is NOT packaged as a west module at its
# repo root - its Kconfig/CMake live inside modules/libmicroros. Register that
# directory as an extra Zephyr module, exactly as the module's own sample app
# does (github.com/micro-ROS/micro_ros_zephyr_module, CMakeLists.txt).
#
# The second module, microros_compat, is a one-line include-path shim needed
# on Zephyr >= 3.4 (see its CMakeLists.txt for the full explanation).
list(APPEND ZEPHYR_EXTRA_MODULES
  ${CMAKE_CURRENT_SOURCE_DIR}/microros_compat
  ${CMAKE_CURRENT_SOURCE_DIR}/../modules/micro_ros_zephyr_module/modules/libmicroros)

find_package(Zephyr REQUIRED HINTS $ENV{ZEPHYR_BASE})
project(microros_nucleo_f767zi)

# Version string printed on the console at boot. CI passes the tag name (or
# "main-<sha>") with -DAPP_VERSION=..., so the firmware can be identified from
# the serial log alone.
set(APP_VERSION "dev" CACHE STRING "Firmware version string")
target_compile_definitions(app PRIVATE APP_VERSION="${APP_VERSION}")

target_sources(app PRIVATE
  src/main.c
  src/udp_transport.c
)
```

## prj.conf
```kconfig
# SPDX-License-Identifier: Apache-2.0
#
# micro-ROS demo for NUCLEO-F767ZI on Zephyr (UDP over Ethernet transport)
#
# Base copy: micro-ROS Zephyr module sample prj.conf
# https://github.com/micro-ROS/micro_ros_zephyr_module

CONFIG_GPIO=y
CONFIG_MICROROS=y
CONFIG_CPP=y

CONFIG_MAIN_STACK_SIZE=25000
CONFIG_MAIN_THREAD_PRIORITY=3

CONFIG_NEWLIB_LIBC=y
CONFIG_NEWLIB_LIBC_NANO=n

CONFIG_POSIX_API=y

CONFIG_STDOUT_CONSOLE=y
CONFIG_LOG=y
CONFIG_SERIAL=y
CONFIG_UART_INTERRUPT_DRIVEN=y
CONFIG_UART_LINE_CTRL=y

# --------------------------------------------------------------
# micro-ROS transport: UDP over Ethernet
# --------------------------------------------------------------
# Kconfig is a choice: pick exactly one transport.
CONFIG_MICROROS_TRANSPORT_UDP=y

# Where the micro-ROS agent (Raspberry Pi, Docker) is reachable.
# *** CHANGE THIS to your Pi's IP (see: hostname -I on the Pi) ***
CONFIG_MICROROS_AGENT_IP="192.168.0.249"
CONFIG_MICROROS_AGENT_PORT="8888"

# --------------------------------------------------------------
# Networking stack (Ethernet, DHCP)
# --------------------------------------------------------------
CONFIG_NETWORKING=y
CONFIG_NET_IPV4=y
CONFIG_NET_UDP=y
CONFIG_NET_L2_ETHERNET=y
CONFIG_ETH_STM32_HAL=y

# LAN8742A PHY on the Nucleo-144 boards sits at SMI address 0 (Zephyr default).
# If you get no link/activity for the eth0 interface, try 1:
# CONFIG_ETH_STM32_HAL_PHY_ADDRESS=1

# Static IPv4 address.
#
# This used to be DHCP. On a busy home LAN the router can keep offering the
# board an address that another device has taken meanwhile; the Zephyr DHCP
# client then probes it (IPv4 ACD), sees the conflict, declines it and retries
# forever, so the board never gets an address. A fixed address makes the demo
# deterministic. Pick one that is free and outside your router's DHCP pool.
CONFIG_NET_DHCPV4=n
CONFIG_NET_CONFIG_SETTINGS=y
CONFIG_NET_CONFIG_MY_IPV4_ADDR="192.168.0.230"
CONFIG_NET_CONFIG_MY_IPV4_NETMASK="255.255.255.0"
CONFIG_NET_CONFIG_MY_IPV4_GW="192.168.0.1"

# Alternative: obtain an address with DHCP (uncomment this and comment out the
# static block above).
# CONFIG_NET_DHCPV4=y

# --------------------------------------------------------------
# Optional networking debug help. Note: in Zephyr 4.1 the per-module
# log level choices depend on the NET_LOG symbol, so enabling them
# here has no visible effect; the app prints its own diagnostics.
# --------------------------------------------------------------
# CONFIG_NET_IF_LOG_LEVEL_DBG=y
# CONFIG_NET_DHCPV4_LOG_LEVEL_DBG=y
```

## prj_picolibc.conf
```kconfig
# SPDX-License-Identifier: Apache-2.0
#
# Picolibc overlay for Zephyr 4.4 and newer.
#
# Zephyr 4.4 requires Zephyr SDK 1.0.x, and that SDK no longer ships newlib.
# Build with this overlay on top of prj.conf:
#
#   west build -b nucleo_f767zi -p always . -- \
#     -DEXTRA_CONF_FILE=prj_picolibc.conf
#
# Zephyr 4.3 is the exception: its own POSIX timer code does not compile
# against picolibc, so keep the newlib default from prj.conf there.

CONFIG_NEWLIB_LIBC=n
CONFIG_PICOLIBC=y
```

## src/main.c
```c
/*
 * SPDX-License-Identifier: Apache-2.0
 *
 * micro-ROS demo application for the NUCLEO-F767ZI board on Zephyr.
 *
 * Transport: UDP over the integrated Ethernet (module transport
 * CONFIG_MICROROS_TRANSPORT_UDP), connecting to a micro-ROS agent
 * (micro-ROS Docker agent) on the Raspberry Pi.
 *
 * Behavior:
 *   - publisher  "zephyr_heartbeat"  std_msgs/msg/Int32   (1 Hz, green LED blink)
 *   - subscriber "zephyr_led_cmd"    std_msgs/msg/Bool    (toggles blue LED)
 *
 * The application follows the micro-ROS reconnection pattern: it pings the
 * agent, creates the node only while the agent answers, and destroys the node
 * again when the connection is lost. The heartbeat counter advances only after
 * a publish that the agent acknowledged, so the green LED stops pretending to
 * be connected while the Pi is down.
 *
 * LEDs (from the Nucleo F767ZI devicetree aliases):
 *   led0 -> green user LED LD1, PB0 -> slow blink when connected,
 *                                      fast blink when the agent is unreachable
 *   led1 -> blue  user LED LD2, PB7 -> toggled on every received command
 */

#include <stdbool.h>
#include <string.h>
#include <stdio.h>

#include <zephyr/kernel.h>
#include <zephyr/device.h>
#include <zephyr/devicetree.h>
#include <zephyr/drivers/gpio.h>
#include <zephyr/net/net_if.h>
#include <zephyr/net/net_ip.h>

#include <rcl/rcl.h>
#include <rcl/error_handling.h>
#include <std_msgs/msg/int32.h>
#include <std_msgs/msg/bool.h>
#include <rclc/rclc.h>
#include <rclc/executor.h>

#include <rmw_microros/rmw_microros.h>
#include <rmw_microros/ping.h>

#include "udp_transport.h"

/* One ping is enough to tell whether the agent answers: the timeout covers a
 * busy LAN, and the outer loop decides when to try again.
 */
#define PING_TIMEOUT_MS           100
#define PING_ATTEMPTS             1

/* While connected, ping once a second. The heartbeat timer runs at the same
 * rate, so a dead agent is noticed within roughly one publish period.
 */
#define CONNECTED_PING_PERIOD_MS  1000

/* While waiting for the agent, retry twice a second. The transport opens and
 * closes a socket per ping, so this is also the reconnect latency.
 */
#define RECONNECT_PING_PERIOD_MS  500

/* Fast blink used while the agent is unreachable. It is clearly different from
 * the 1 s heartbeat so the two states cannot be confused.
 */
#define DISCONNECTED_BLINK_MS     100

#define LED_HEARTBEAT_NODE DT_ALIAS(led0)
#define LED_COMMAND_NODE   DT_ALIAS(led1)

static const struct gpio_dt_spec led_heartbeat =
	GPIO_DT_SPEC_GET(LED_HEARTBEAT_NODE, gpios);
static const struct gpio_dt_spec led_command =
	GPIO_DT_SPEC_GET(LED_COMMAND_NODE, gpios);

static bool leds_ready;

static rclc_support_t support;
static rcl_node_t node;
static rclc_executor_t executor;
static rcl_publisher_t heartbeat_publisher;
static std_msgs__msg__Int32 heartbeat_msg;
static rcl_timer_t heartbeat_timer;
static rcl_subscription_t led_cmd_subscription;
static std_msgs__msg__Bool led_cmd_msg;

enum connection_state {
	CONN_WAITING_AGENT,
	CONN_AGENT_AVAILABLE,
	CONN_AGENT_CONNECTED,
	CONN_AGENT_DISCONNECTED,
};

static void heartbeat_led_set(bool on)
{
	if (leds_ready) {
		gpio_pin_set_dt(&led_heartbeat, on ? 1 : 0);
	}
}

static void heartbeat_led_toggle(void)
{
	if (leds_ready) {
		gpio_pin_toggle_dt(&led_heartbeat);
	}
}

static bool period_elapsed(int64_t *last_ms, int64_t period_ms)
{
	int64_t now = k_uptime_get();

	if (now - *last_ms < period_ms) {
		return false;
	}

	*last_ms = now;
	return true;
}

static void update_disconnected_led(int64_t *last_toggle_ms, bool *led_on)
{
	if (!period_elapsed(last_toggle_ms, DISCONNECTED_BLINK_MS)) {
		return;
	}

	*led_on = !*led_on;
	heartbeat_led_set(*led_on);
}

static void heartbeat_timer_callback(rcl_timer_t *timer, int64_t last_call_time)
{
	rcl_ret_t rc;

	RCLC_UNUSED(last_call_time);

	if (timer == NULL) {
		return;
	}

	/* Advance the counter and blink only when the agent confirmed the sample.
	 * The default publisher QoS is reliable, so rcl_publish() waits for the
	 * XRCE acknowledgement and fails when the link is gone. Best-effort
	 * publishing would report success for a UDP datagram that nobody reads.
	 */
	rc = rcl_publish(&heartbeat_publisher, &heartbeat_msg, NULL);
	if (rc != RCL_RET_OK) {
		printk("heartbeat publish failed (%d), not advancing\n", (int)rc);
		return;
	}

	heartbeat_msg.data++;
	heartbeat_led_toggle();
}

static void led_cmd_subscription_callback(const void *msgin)
{
	const std_msgs__msg__Bool *msg = (const std_msgs__msg__Bool *)msgin;
	static int last_state = -1;

	/* Level command, not a toggle: "true" turns the LED on, "false" off.
	 * Idempotent, so publishing the command several times (or retrying
	 * because a DDS discovery race ate the first sample) is harmless.
	 */
	if (leds_ready) {
		gpio_pin_set_dt(&led_command, msg->data ? 1 : 0);
	}

	/* Log only real changes: this is the moment the command took effect, so
	 * the console timestamp shows whether a "slow" command was late on the
	 * wire or late on the board.
	 */
	if ((int)msg->data != last_state) {
		last_state = (int)msg->data;
		printk("led_cmd: %s @ %lld ms\n",
		       msg->data ? "on" : "off", k_uptime_get());
	}
}

static int leds_init(void)
{
	int ret;

	if (!gpio_is_ready_dt(&led_heartbeat)) {
		return -ENODEV;
	}
	if (!gpio_is_ready_dt(&led_command)) {
		return -ENODEV;
	}

	ret = gpio_pin_configure_dt(&led_heartbeat, GPIO_OUTPUT_INACTIVE);
	if (ret < 0) {
		return ret;
	}
	ret = gpio_pin_configure_dt(&led_command, GPIO_OUTPUT_INACTIVE);
	if (ret < 0) {
		return ret;
	}

	leds_ready = true;
	return 0;
}

/*
 * Wait until the Ethernet interface has an IPv4 address. Pinging before the
 * address is assigned only produces failed socket opens (and, in the stock
 * module transport, leaked file descriptors).
 */
static void wait_for_ipv4(void)
{
	struct net_if *iface;
	unsigned int elapsed = 0;

	while ((iface = net_if_get_default()) == NULL) {
		k_msleep(100);
	}

	{
		struct net_linkaddr *mac = net_if_get_link_addr(iface);

		if (mac != NULL && mac->len >= 6) {
			printk("net: MAC %02x:%02x:%02x:%02x:%02x:%02x\n",
			       mac->addr[0], mac->addr[1], mac->addr[2],
			       mac->addr[3], mac->addr[4], mac->addr[5]);
		}
	}

	for (;;) {
		struct in_addr *addr =
			net_if_ipv4_get_global_addr(iface, NET_ADDR_ANY_STATE);

		if (addr != NULL) {
			char buf[NET_IPV4_ADDR_LEN];

			printk("net: %s is %s\n",
			       net_if_get_device(iface)->name,
			       net_addr_ntop(AF_INET, addr, buf, sizeof(buf)));
			return;
		}

		/* Distinguish "no cable" from "the address was never assigned". */
		if (elapsed == 0) {
			printk("net: waiting for an IPv4 address on %s\n",
			       net_if_get_device(iface)->name);
		} else if (elapsed % 2 == 0) {
			printk("net: no IPv4 yet (%us): carrier %s, iface %s\n",
			       elapsed,
			       net_if_is_carrier_ok(iface) ? "up" : "DOWN",
			       net_if_is_up(iface) ? "up" : "DOWN");
		}

		k_msleep(1000);
		elapsed++;
	}
}

/*
 * Create the node and its endpoints. Any partial failure is unwound here so the
 * state machine never has to guess how far creation got.
 */
static bool create_entities(void)
{
	rcl_allocator_t allocator = rcl_get_default_allocator();
	rcl_ret_t rc;

	rc = rclc_support_init(&support, 0, NULL, &allocator);
	if (rc != RCL_RET_OK) {
		printk("micro-ROS init failed (%d)\n", (int)rc);
		return false;
	}

	rc = rclc_node_init_default(&node, "nucleo_f767zi_node", "", &support);
	if (rc != RCL_RET_OK) {
		printk("node creation failed (%d)\n", (int)rc);
		goto fail_support;
	}

	rc = rclc_publisher_init_default(
		&heartbeat_publisher,
		&node,
		ROSIDL_GET_MSG_TYPE_SUPPORT(std_msgs, msg, Int32),
		"zephyr_heartbeat");
	if (rc != RCL_RET_OK) {
		printk("heartbeat publisher creation failed (%d)\n", (int)rc);
		goto fail_node;
	}

	rc = rclc_subscription_init_default(
		&led_cmd_subscription,
		&node,
		ROSIDL_GET_MSG_TYPE_SUPPORT(std_msgs, msg, Bool),
		"zephyr_led_cmd");
	if (rc != RCL_RET_OK) {
		printk("LED subscription creation failed (%d)\n", (int)rc);
		goto fail_publisher;
	}

	rc = rclc_timer_init_default2(
		&heartbeat_timer,
		&support,
		RCL_MS_TO_NS(1000),
		heartbeat_timer_callback,
		true);
	if (rc != RCL_RET_OK) {
		printk("heartbeat timer creation failed (%d)\n", (int)rc);
		goto fail_subscription;
	}

	rc = rclc_executor_init(&executor, &support.context, 2, &allocator);
	if (rc != RCL_RET_OK) {
		printk("executor creation failed (%d)\n", (int)rc);
		goto fail_executor;
	}

	rc = rclc_executor_add_timer(&executor, &heartbeat_timer);
	if (rc != RCL_RET_OK) {
		printk("adding the heartbeat timer failed (%d)\n", (int)rc);
		goto fail_executor;
	}

	rc = rclc_executor_add_subscription(
		&executor, &led_cmd_subscription, &led_cmd_msg,
		&led_cmd_subscription_callback, ON_NEW_DATA);
	if (rc != RCL_RET_OK) {
		printk("adding the LED subscription failed (%d)\n", (int)rc);
		goto fail_executor;
	}

	return true;

fail_executor:
	(void)rclc_executor_fini(&executor);
fail_timer:
	(void)rcl_timer_fini(&heartbeat_timer);
fail_subscription:
	(void)rcl_subscription_fini(&led_cmd_subscription, &node);
fail_publisher:
	(void)rcl_publisher_fini(&heartbeat_publisher, &node);
fail_node:
	(void)rcl_node_fini(&node);
fail_support:
	(void)rclc_support_fini(&support);
	return false;
}

static void destroy_entities(void)
{
	rmw_context_t *rmw_context = rcl_context_get_rmw_context(&support.context);

	/* The agent is already gone. Waiting for the session timeout of every
	 * entity would only stall the loop, so destroy them immediately.
	 */
	(void)rmw_uros_set_context_entity_destroy_session_timeout(rmw_context, 0);

	(void)rclc_executor_fini(&executor);
	(void)rcl_timer_fini(&heartbeat_timer);
	(void)rcl_subscription_fini(&led_cmd_subscription, &node);
	(void)rcl_publisher_fini(&heartbeat_publisher, &node);
	(void)rcl_node_fini(&node);
	(void)rclc_support_fini(&support);
}

int main(void)
{
	int ret;
	static app_udp_params_t transport_params = {
		.fd = -1,
	};
	enum connection_state state = CONN_WAITING_AGENT;
	int64_t last_ping_ms;
	int64_t last_blink_ms;
	bool led_on = false;
	unsigned int attempts = 0;

	printk("\nmicro-ROS demo %s\n", APP_VERSION);

	ret = leds_init();
	if (ret < 0) {
		printk("LED init failed (%d), continuing without LEDs\n", ret);
	}

	wait_for_ipv4();

	strcpy(transport_params.ip, CONFIG_MICROROS_AGENT_IP);
	strcpy(transport_params.port, CONFIG_MICROROS_AGENT_PORT);
	printk("micro-ROS UDP agent target %s:%s\n",
	       transport_params.ip, transport_params.port);

	rmw_uros_set_custom_transport(
		false, /* UDP datagrams are already framed by XRCE */
		(void *)&transport_params,
		app_udp_open,
		app_udp_close,
		app_udp_write,
		app_udp_read);

	heartbeat_msg.data = 0;

	/* Ping immediately on the first pass. */
	last_ping_ms = k_uptime_get() - RECONNECT_PING_PERIOD_MS;
	last_blink_ms = k_uptime_get();

	for (;;) {
		switch (state) {
		case CONN_WAITING_AGENT:
			update_disconnected_led(&last_blink_ms, &led_on);

			if (period_elapsed(&last_ping_ms,
					   RECONNECT_PING_PERIOD_MS)) {
				if (rmw_uros_ping_agent(PING_TIMEOUT_MS,
							PING_ATTEMPTS) == RMW_RET_OK) {
					state = CONN_AGENT_AVAILABLE;
					break;
				}

				attempts++;
				if (attempts <= 10 || attempts % 10 == 0) {
					printk("Waiting for the micro-ROS agent (%s:%s), attempt %u...\n",
					       CONFIG_MICROROS_AGENT_IP,
					       CONFIG_MICROROS_AGENT_PORT,
					       attempts);
				}
			}

			k_msleep(10);
			break;

		case CONN_AGENT_AVAILABLE:
			if (!create_entities()) {
				state = CONN_WAITING_AGENT;
				last_ping_ms = k_uptime_get();
				break;
			}

			printk("micro-ROS agent reachable, node created\n");
			printk("micro-ROS node running: publishing /zephyr_heartbeat, subscribing /zephyr_led_cmd\n");
			attempts = 0;
			led_on = false;
			heartbeat_led_set(false);
			last_ping_ms = k_uptime_get();
			state = CONN_AGENT_CONNECTED;
			break;

		case CONN_AGENT_CONNECTED:
			if (period_elapsed(&last_ping_ms,
					   CONNECTED_PING_PERIOD_MS) &&
			    rmw_uros_ping_agent(PING_TIMEOUT_MS,
						PING_ATTEMPTS) != RMW_RET_OK) {
				printk("micro-ROS agent lost, dropping the session\n");
				state = CONN_AGENT_DISCONNECTED;
				break;
			}

			/* Spin with a 1 ms wait instead of 10 ms + k_msleep(10),
			 * so a command is handed to the subscription callback
			 * within ~1-2 ms of arriving on the socket.
			 */
			(void)rclc_executor_spin_some(&executor,
						      RCL_MS_TO_NS(1));
			k_msleep(1);
			break;

		case CONN_AGENT_DISCONNECTED:
			destroy_entities();
			heartbeat_led_set(false);
			led_on = false;
			attempts = 0;
			last_blink_ms = k_uptime_get();
			last_ping_ms = k_uptime_get();
			state = CONN_WAITING_AGENT;
			break;
		}
	}
}
```

## src/udp_transport.c
```c
/*
 * SPDX-License-Identifier: Apache-2.0
 *
 * Minimal UDP transport for micro-ROS on Zephyr.
 *
 * The socket is created once per transport open and always closed on any
 * failure path, so repeated ping attempts cannot exhaust the fd table.
 */

#include <errno.h>
#include <stdlib.h>
#include <string.h>

#include <zephyr/kernel.h>
#include <zephyr/net/socket.h>

#include "udp_transport.h"

bool app_udp_open(struct uxrCustomTransport *transport)
{
	app_udp_params_t *params = (app_udp_params_t *)transport->args;
	struct sockaddr_in agent = {0};

	if (params->fd >= 0) {
		return true;
	}

	params->fd = zsock_socket(AF_INET, SOCK_DGRAM, IPPROTO_UDP);
	if (params->fd < 0) {
		printk("udp: socket() failed (errno %d)\n", errno);
		return false;
	}

	agent.sin_family = AF_INET;
	agent.sin_port = htons((uint16_t)strtoul(params->port, NULL, 10));

	if (zsock_inet_pton(AF_INET, params->ip, &agent.sin_addr) != 1) {
		printk("udp: invalid agent address '%s'\n", params->ip);
		goto fail;
	}

	if (zsock_connect(params->fd, (struct sockaddr *)&agent,
			  sizeof(agent)) < 0) {
		printk("udp: connect() to %s:%s failed (errno %d)\n",
		       params->ip, params->port, errno);
		goto fail;
	}

	if (!params->open_logged) {
		printk("udp: socket %d connected to %s:%s\n",
		       params->fd, params->ip, params->port);
		params->open_logged = true;
	}
	return true;

fail:
	(void)zsock_close(params->fd);
	params->fd = -1;
	return false;
}

bool app_udp_close(struct uxrCustomTransport *transport)
{
	app_udp_params_t *params = (app_udp_params_t *)transport->args;
	int fd = params->fd;

	if (fd < 0) {
		return true;
	}

	params->fd = -1;
	return zsock_close(fd) == 0;
}

size_t app_udp_write(struct uxrCustomTransport *transport,
		     const uint8_t *buf, size_t len, uint8_t *err)
{
	app_udp_params_t *params = (app_udp_params_t *)transport->args;
	ssize_t sent;

	if (params->fd < 0) {
		*err = 1;
		return 0;
	}

	sent = zsock_send(params->fd, buf, len, 0);
	if (sent < 0) {
		printk("udp: send() failed (errno %d)\n", errno);
		*err = 1;
		return 0;
	}

	*err = 0;
	return (size_t)sent;
}

size_t app_udp_read(struct uxrCustomTransport *transport,
		    uint8_t *buf, size_t len, int timeout, uint8_t *err)
{
	app_udp_params_t *params = (app_udp_params_t *)transport->args;
	struct zsock_pollfd pfd;
	ssize_t received;
	int ready;

	if (params->fd < 0) {
		*err = 1;
		return 0;
	}

	pfd.fd = params->fd;
	pfd.events = ZSOCK_POLLIN;
	pfd.revents = 0;

	ready = zsock_poll(&pfd, 1, timeout);
	if (ready == 0) {
		/* Timeout is not an error: the caller decides what to do. */
		*err = 0;
		return 0;
	}
	if (ready < 0) {
		printk("udp: poll() failed (errno %d)\n", errno);
		*err = 1;
		return 0;
	}

	received = zsock_recv(params->fd, buf, len, 0);
	if (received < 0) {
		printk("udp: recv() failed (errno %d)\n", errno);
		*err = 1;
		return 0;
	}

	*err = 0;
	return (size_t)received;
}
```

## src/udp_transport.h
```c
/*
 * SPDX-License-Identifier: Apache-2.0
 *
 * Minimal UDP transport for micro-ROS on Zephyr.
 *
 * This replaces the transport shipped in micro_ros_zephyr_module, which:
 *   - resolves the agent address with getaddrinfo(), which needs a heap
 *     (and is pointless for a numeric IPv4 address);
 *   - leaks the socket descriptor whenever socket()/connect() fails, so
 *     the ping-retry loop can exhaust the fd table before DHCP finishes;
 *   - prints nothing when it fails, leaving the console stuck on
 *     "Waiting for the micro-ROS agent...".
 */

#ifndef APP_UDP_TRANSPORT_H_
#define APP_UDP_TRANSPORT_H_

#include <stdbool.h>
#include <stddef.h>
#include <stdint.h>

#include <uxr/client/profile/transport/custom/custom_transport.h>

typedef struct {
	char ip[16];
	char port[6];
	int fd;
	/* Set after the first successful open, so the reconnect loop does not
	 * print a socket line every time it probes for the agent.
	 */
	bool open_logged;
} app_udp_params_t;

bool app_udp_open(struct uxrCustomTransport *transport);
bool app_udp_close(struct uxrCustomTransport *transport);
size_t app_udp_write(struct uxrCustomTransport *transport,
		     const uint8_t *buf, size_t len, uint8_t *err);
size_t app_udp_read(struct uxrCustomTransport *transport,
		    uint8_t *buf, size_t len, int timeout, uint8_t *err);

#endif /* APP_UDP_TRANSPORT_H_ */
```
